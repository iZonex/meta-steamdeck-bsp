## conf/layer.conf
```bitbake
# We have a conf and classes directory, add to BBPATH
BBPATH .= ":${LAYERDIR}"

# We have recipes-* directories, add to BBFILES
BBFILES += "${LAYERDIR}/recipes-*/*/*.bb \
            ${LAYERDIR}/recipes-*/*/*.bbappend"

BBFILE_COLLECTIONS += "steamdeck-bsp"
BBFILE_PATTERN_steamdeck-bsp = "^${LAYERDIR}/"
BBFILE_PRIORITY_steamdeck-bsp = "10"

LAYERVERSION_steamdeck-bsp = "2"
LAYERSERIES_COMPAT_steamdeck-bsp = "scarthgap walnasacar"

# Layer dependencies
LAYERDEPENDS_steamdeck-bsp = "core openembedded-layer meta-python networking-layer multimedia-layer meta-amd-bsp" 
```

## conf/machine/steamdeck-oled.conf
```bitbake
#@TYPE: Machine
#@NAME: Steam Deck OLED
#@DESCRIPTION: Machine configuration for Steam Deck OLED model based on AMD Van Gogh APU

# Architecture and tune - AMD x86_64
require conf/machine/include/x86/arch-x86.inc
require conf/machine/include/x86/x86-base.inc

# Set tune for x86_64 architecture - use standard x86-64 tune
DEFAULTTUNE = "x86-64"

# Kernel - use standard linux-yocto
PREFERRED_PROVIDER_virtual/kernel ?= "linux-yocto"
PREFERRED_VERSION_linux-yocto ?= "6.6%"

# Bootloader
EFI_PROVIDER = "systemd-boot"
MACHINE_FEATURES_BACKFILL_CONSIDERED = "rtc"

# Machine features
MACHINE_FEATURES = "acpi alsa bluetooth efi keyboard pci screen usbhost wifi x86"
MACHINE_FEATURES += "vulkan opengl"

# Display configuration
XSERVER = "xserver-xorg \
           mesa-driver-radeonsi \
           xf86-video-amdgpu \
           xf86-input-libinput \
           xf86-input-evdev"

# GPU and graphics
PACKAGECONFIG:append:pn-mesa = " radeonsi"
GALLIUM_DRIVER = "radeonsi"

# Audio
MACHINE_EXTRA_RDEPENDS += "alsa-utils alsa-plugins pulseaudio"

# Steam Deck specific hardware support
MACHINE_EXTRA_RDEPENDS += " \
    steamdeck-tools \
    linux-firmware \
"

# Optional firmware (may not be available in all builds)
MACHINE_EXTRA_RRECOMMENDS += " \
    steamdeck-firmware \
    linux-firmware-amdgpu \
    linux-firmware-rtw89 \
"

# Image and rootfs
IMAGE_FSTYPES = "wic wic.bmap ext4"
WKS_FILE = "steamdeck-oled.wks"

# Serial console
SERIAL_CONSOLES = "115200;ttyS0"

# Root filesystem extra space (in KB)
IMAGE_ROOTFS_EXTRA_SPACE = "2097152"

# Enable systemd
INIT_MANAGER = "systemd"

# Use systemd-boot for EFI
WKS_FILE_DEPENDS = "systemd-boot" 
```

## wic/steamdeck-installer.wks
```
# Steam Deck Installer USB Layout
# Bootable USB installer with failsafe and dual boot support

# EFI boot partition for installer
part /boot --source bootimg-efi --sourceparams="loader=systemd-boot" --label installer-efi --active --align 1024 --size 512

# Root filesystem with installer tools
part / --source rootfs --ondisk sda --fstype=ext4 --label installer-root --align 1024 --size 2048 --extra-space 512 
```

## wic/steamdeck-oled-dualboot.wks
```
# Steam Deck OLED Dual Boot + Failsafe Layout
# This layout supports:
# - Dual boot with original SteamOS (if preserved)
# - A/B root partitions for failsafe updates
# - Shared EFI partition for multiple OS
# - Recovery partition for emergencies

# Shared EFI boot partition (larger for multiple systems)
part /boot --source bootimg-efi --sourceparams="loader=systemd-boot" --label shared-efi --active --align 1024 --size 1024

# A/B root partitions for failsafe updates
part / --source rootfs --ondisk sda --fstype=ext4 --label rootfs-a --align 1024 --size 8192 --extra-space 2048
part --ondisk sda --fstype=ext4 --label rootfs-b --align 1024 --size 8192

# Shared swap partition
part --ondisk sda --fstype=swap --label shared-swap --align 1024 --size 4096

# Recovery partition with tools and backup images
part --ondisk sda --fstype=ext4 --label recovery --align 1024 --size 2048

# Shared data partition (for Steam games, user data)
part --ondisk sda --fstype=ext4 --label shared-data --align 1024 --size 16384

# Reserve space for original SteamOS (if user wants to keep it)
# part --ondisk sda --fstype=ext4 --label steamos-root --align 1024 --size 8192 
```

## wic/steamdeck-oled.wks
```
# Steam Deck OLED disk layout
# EFI boot partition
part /boot --source bootimg-efi --sourceparams="loader=systemd-boot" --label boot --active --align 1024 --size 256

# Root filesystem
part / --source rootfs --ondisk sda --fstype=ext4 --label rootfs --align 1024 --size 8192 --extra-space 2048 
```
